#include <SPI.h>
#include <Wire.h>
#include <Adafruit_GFX.h>
#include <Adafruit_SSD1306.h>

#define SCREEN_WIDTH 128
#define SCREEN_HEIGHT 64

#define OLED_RESET     -1
Adafruit_SSD1306 display(SCREEN_WIDTH, SCREEN_HEIGHT, &Wire, OLED_RESET);

// 24x32 upward arrow with 8-pixel-wide stem
#define IMAGE_WIDTH  24
#define IMAGE_HEIGHT 32
static const unsigned char PROGMEM arrow_up_bmp[] = {
  B00000000, B00011000, B00000000,
  B00000000, B00111100, B00000000,
  B00000000, B01111110, B00000000,
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  B00000000, B11111111, B00000000
};

// 24x32 downward arrow with 8-pixel-wide stem (rows reversed)
static const unsigned char PROGMEM arrow_down_bmp[] = {
  B00000000, B11111111, B00000000,
  B00000000, B11111111, B00000000,
  B00000000, B11111111, B00000000,
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  B00000000, B00011000, B00000000
};

int currentArrow = 0;  // 0 = Up, 1 = Down

void setup() {
  Serial.begin(115200);
  if(!display.begin(SSD1306_SWITCHCAPVCC, 0x3C)) {
    Serial.println(F("SSD1306 allocation failed"));
    for(;;);
  }

  display.clearDisplay();
  display.display();
}

void loop() {
  // Clear the display before drawing the new arrow
  display.clearDisplay();

  // Draw the appropriate arrow based on the currentArrow value
  if (currentArrow == 0) {
    display.drawBitmap(
      (SCREEN_WIDTH - IMAGE_WIDTH) / 2,    // Center horizontally
      (SCREEN_HEIGHT - IMAGE_HEIGHT) / 2,   // Center vertically
      arrow_up_bmp, IMAGE_WIDTH, IMAGE_HEIGHT, WHITE);
  } else {
    display.drawBitmap(
      (SCREEN_WIDTH - IMAGE_WIDTH) / 2,    // Center horizontally
      (SCREEN_HEIGHT - IMAGE_HEIGHT) / 2,   // Center vertically
      arrow_down_bmp, IMAGE_WIDTH, IMAGE_HEIGHT, WHITE);
  }

  // Update the display
  display.display();
  
  // Switch between arrows every 1 second
  delay(1000);
  currentArrow = !currentArrow;  // Toggle between 0 (Up) and 1 (Down)
}

